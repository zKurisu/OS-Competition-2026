## tests/boot.its
```
/dts-v1/;

/ {
    description = "SG2002 StarryOS kernel and board FDT";
    #address-cells = <2>;
    images {
        kernel-1 {
            description = "starryos kernel";
            data = /incbin/("./starryos.bin");
            type = "kernel";
            arch = "riscv";
            os = "linux";
            compression = "none";
            load = <0x0 0x80200000>;
            entry = <0x0 0x80200000>;
            hash-1 { algo = "crc32"; };
        };
        fdt-1 {
            description = "sg2002 licheervnano dtb";
            data = /incbin/("./licheerv-nano-sg2002.dtb");
            type = "flat_dt";
            arch = "riscv";
            compression = "none";
            hash-1 { algo = "sha256"; };
        };
    };
    configurations {
        config-sg2002_licheervnano_sd {
            description = "boot starryos with board sg2002 licheervnano";
            kernel = "kernel-1";
            fdt = "fdt-1";
        };
    };
};
```
